## os/yocto/layers/meta-dstack/conf/distro/dstack.conf
```bitbake
# Select systemd init before requiring poky-derived distro config, otherwise
# poky.conf's POKY_INIT_MANAGER="sysvinit" pulls init-manager-sysvinit.inc which
# appends sysvinit to DISTRO_FEATURES and conflicts with systemd (breaks udev).
INIT_MANAGER = "systemd"
require conf/distro/cvm.conf
DISTRO = "dstack"
DISTRO_NAME = "DStack"
DISTRO_FEATURES:append = " virtualization seccomp systemd usrmerge security dm-verity ipv6"

DISTRO_VERSION = "0.6.0"
DISTROOVERRIDES = "poky:dstack"
INITRAMFS_IMAGE = ""

PREFERRED_PROVIDER_virtual/kernel = "linux-yocto"
PREFERRED_VERSION_linux-yocto ?= "6.18%"
LINUX_KERNEL_TYPE = "tiny"

MACHINE_FEATURES += "numa"

VIRTUAL-RUNTIME_init_manager = "systemd"
VIRTUAL-RUNTIME_initscripts = ""
VIRTUAL-RUNTIME_dev_manager = "systemd"

SERIAL_CONSOLES = "115200;ttyS0"
PREFERRED_VERSION_rust-bin-cross-x86_64 = "1.92.0"
PREFERRED_VERSION_cargo-bin-cross-x86_64 = "1.92.0"

# NVIDIA driver stack (included in the default images).
# Bump all three together — kernel module ABI is paired with userspace libs.
NVIDIA_VERSION = "595.58.03"
PREFERRED_VERSION_nvidia = "${NVIDIA_VERSION}"
PREFERRED_VERSION_nvidia-fabricmanager = "${NVIDIA_VERSION}"
PREFERRED_VERSION_libnvidia-nscq = "${NVIDIA_VERSION}"

BAD_RECOMMENDATIONS = "busybox-syslog systemd-compat-units"

# Skip unused components that fail metadata checks
SKIP_RECIPE[ostree] = "not required for dstack"

# Suppress meta-tpm warning (we use TPM drivers directly without tpm2 DISTRO_FEATURES)
SKIP_META_TPM_SANITY_CHECK = "1"

# EFI/UKI support for GCP images
MACHINE_FEATURES:append = " efi"
EFI_PROVIDER = "systemd-boot"
```

## os/yocto/layers/meta-dstack/conf/layer.conf
```bitbake
BBPATH .= ":${LAYERDIR}"
BBFILES += "${LAYERDIR}/recipes-*/*/*.bb ${LAYERDIR}/recipes-*/*/*.bbappend"

BBFILE_COLLECTIONS += "dstack"
BBFILE_PATTERN_dstack := "^${LAYERDIR}/"
BBFILE_PRIORITY_dstack = "20"
LAYERVERSION_dstack = "4"
LAYERSERIES_COMPAT_dstack = "wrynose"
```

## os/yocto/layers/meta-dstack/conf/machine/dstack.conf
```bitbake
#@TYPE: Machine
#@NAME: dstack confidential guest
#@DESCRIPTION: Unified dstack confidential-guest machine. A single image that
#              boots on both Intel TDX and AMD SEV-SNP hosts; the kernel
#              detects the platform at runtime. Kernel feature fragments
#              (tdx.scc / sev-snp.scc / ...) are reused from
#              meta-confidential-compute via KERNEL_FEATURES in the
#              linux-yocto bbappend.
#
# The QEMU/tune boilerplate below mirrors the generic x86-64 confidential-guest
# machines in meta-confidential-compute (tdx.conf / sev-snp.conf). It is kept
# self-contained here so the dstack machine does not depend on that layer's
# machine names.

# from require conf/machine/include/qemu.inc
# Don't include kernels in standard images
RDEPENDS:${KERNEL_PACKAGE_NAME}-base = ""

# Use a common kernel recipe for all QEMU machines
PREFERRED_PROVIDER_virtual/kernel ??= "linux-yocto-tiny"

EXTRA_IMAGEDEPENDS += "qemu-system-native qemu-helper-native:do_addto_recipe_sysroot"

# from require conf/machine/include/x86/qemuboot-x86.inc
# For runqemu
IMAGE_CLASSES += "qemuboot"
QB_SMP ?= "-smp 4"
QB_CPU:x86 ?= "-cpu IvyBridge -machine q35,i8042=off"
QB_CPU_KVM:x86 ?= "-cpu IvyBridge -machine q35,i8042=off"

QB_CPU:x86-64 ?= "-cpu IvyBridge -machine q35,i8042=off"
QB_CPU_KVM:x86-64 ?= "-cpu IvyBridge -machine q35,i8042=off"

# No QB_KERNEL_CMDLINE_APPEND: that only affects `runqemu` test boots, not the
# production image cmdline (built in mkimage.sh). The tdx machine inherited one
# that disabled the Spectre v2 mitigation (nospectre_v2); dropping it keeps test
# boots at the kernel's default mitigations, matching production.
QB_OPT_APPEND = "-usb -device usb-tablet -usb -device usb-kbd"

DEFAULTTUNE ?= "x86-64-v3"

require conf/machine/include/x86/tune-x86-64-v3.inc

KERNEL_IMAGETYPE = "bzImage"

SERIAL_CONSOLES ?= "115200;ttyS0 115200;ttyS1"

MACHINE_FEATURES += "x86 pci tpm2"

do_image_wic[depends] += "syslinux:do_populate_sysroot syslinux-native:do_populate_sysroot mtools-native:do_populate_sysroot dosfstools-native:do_populate_sysroot"

# For runqemu
QB_SYSTEM_NAME = "dstack"
```
